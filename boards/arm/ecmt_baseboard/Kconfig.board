## boards/arm/ecmt_baseboard/Kconfig.board
```kconfig
#
# Copyright (c) 2020 Ecomott, Inc.
#
# SPDX-License-Identifier: Apache-2.0
#

config BOARD_ECMT_BASEBOARD
	bool "Ecomott Baseboard"
	depends on SOC_STM32L152XE
```

## boards/arm/ecmt_baseboard/Kconfig.defconfig
```kconfig
#
# Copyright (c) 2020 Ecomott, Inc.
#
# SPDX-License-Identifier: Apache-2.0
#

if BOARD_ECMT_BASEBOARD

config BOARD
	default "ecmt_baseboard"

if UART_CONSOLE

config UART_1
	default y

endif # UART_CONSOLE

if I2C

config I2C_1
	default y

config I2C_2
	default y

config I2C_STM32_INTERRUPT
	default y

endif # I2C

if ADC

config ADC_1
	default y

endif # ADC

config USE_STM32_HAL_PWR
	default y

endif # BOARD_ECMT_BASEBOARD
```

## boards/arm/ecmt_baseboard/ecmt_baseboard_defconfig
```kconfig
# SPDX-License-Identifier: Apache-2.0

CONFIG_SOC_SERIES_STM32L1X=y
CONFIG_SOC_STM32L152XE=y
CONFIG_CORTEX_M_SYSTICK=y
# 32MHz system clock
CONFIG_SYS_CLOCK_HW_CYCLES_PER_SEC=32000000

# enable uart driver
CONFIG_SERIAL=y

# enable console
CONFIG_CONSOLE=y
CONFIG_UART_CONSOLE=y

# enable pinmux
CONFIG_PINMUX=y

# enable GPIO
CONFIG_GPIO=y

##### Clock configuration #####
CONFIG_CLOCK_CONTROL=y
# Use PLL as SYSCLK
CONFIG_CLOCK_STM32_SYSCLK_SRC_PLL=y
# Use HSI source
CONFIG_CLOCK_STM32_PLL_SRC_HSI=y
CONFIG_CLOCK_STM32_PLL_MULTIPLIER=6
CONFIG_CLOCK_STM32_PLL_DIVISOR=3
# produce 32Mhz clock at PLL output
CONFIG_CLOCK_STM32_AHB_PRESCALER=1
CONFIG_CLOCK_STM32_APB1_PRESCALER=1
CONFIG_CLOCK_STM32_APB2_PRESCALER=1
# Use LSE for RTC
CONFIG_COUNTER_RTC_STM32_CLOCK_LSE=y
CONFIG_COUNTER_RTC_STM32_LSE_BYPASS=y
```

## drivers/sdhc/Kconfig.xlnx
```kconfig
# Copyright (c) 2025 Advanced Micro Devices, Inc. (AMD)
# SPDX-License-Identifier: Apache-2.0

config XLNX_SDHC
	bool "xlnx sdhc driver"
	default y
	depends on DT_HAS_XLNX_VERSAL_8_9A_ENABLED
	select SDHC_SUPPORTS_NATIVE_MODE
	select SDHC_SUPPORTS_UHS
	select EVENTS
	select CLOCK_CONTROL
	select CLOCK_CONTROL_FIXED_RATE_CLOCK
	help
	  Enable xilinx SD/EMMC host controller driver

if XLNX_SDHC

# sdhc needs 32 byte aligned buffers
config SDHC_BUFFER_ALIGNMENT
	default 32

config HOST_ADMA2_DESC_SIZE
	int "Max descriptor SIZE"
	default 32
	help
	  Set max number of descriptors supported

config SDHC_XLNX_DMA_BOUNCE
	bool "Enable OCM bounce buffer for Xilinx SDHC DMA"
	default y
	depends on DT_HAS_XLNX_VERSAL_OCM_ENABLED
	help
	  Enable DMA bounce buffering using OCM for Xilinx SDHC.
	  If a buffer passed to the SDHC driver is outside the OCM range,
	  a bounce buffer in OCM is used automatically.

config SDHC_XLNX_BOUNCE_SIZE
	int "Bounce buffer size (bytes)"
	default 65536
	depends on SDHC_XLNX_DMA_BOUNCE
	help
	  Set the size of the per-controller bounce buffer in OCM.
	  Must be a multiple of 512 for SD/eMMC block transfers.
	  Should be at least the maximum transfer size expected.

config SDHC_XLNX_BOUNCE_WARN
	bool "Warn when SDHC DMA buffer is outside OCM"
	default y
	depends on SDHC_XLNX_DMA_BOUNCE

endif
```

## dts/bindings/arm/xlnx,versal-ocm.yaml
```yaml
# SPDX-License-Identifier: Apache-2.0

description: Xilinx Versal OCM (On-Chip Memory)

compatible: "xlnx,versal-ocm"

include: base.yaml

properties:
  reg:
    required: true
```

## modules/Kconfig.libklt
```kconfig
# Copyright (c) 2020 Ecomott, Inc.
#
# SPDX-License-Identifier: Apache-2.0

config LIBKLT
	bool "KLT(Kanade–Lucas–Tomasi) Tracker Library Support"
	depends on NEWLIB_LIBC
	help
	  This option enables the KLT Tracker library.
```
